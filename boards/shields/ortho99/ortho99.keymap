#include <behaviors.dtsi>
#include <dt-bindings/zmk/keys.h>
#include <dt-bindings/zmk/rgb.h>
#include <dt-bindings/zmk/bt.h>
#include <dt-bindings/zmk/outputs.h>

/*
 * Layer
 */
#define BASE 0
#define FN   1

/*
 * Japanese JIS aliases
 *
 * Windows側は「日本語キーボード」のまま使用します。
 */
#define JP_ZKHK GRAVE    // 半角/全角/漢字
#define JP_MINS MINUS    // -
#define JP_CIRC EQUAL    // ^
#define JP_YEN  INT3     // ¥
#define JP_AT   LBKT     // @
#define JP_LBRC RBKT     // [
#define JP_SCLN SEMI     // ;
#define JP_COLN SQT      // :
#define JP_RBRC NUHS     // ]
#define JP_BSLS INT1     // \ / ろ
#define JP_KANA INT2     // カタカナ/ひらがな/ローマ字

/ {
    keymap {
        compatible = "zmk,keymap";

        /* =========================================================
         * BASE layer
         * ========================================================= */
        base_layer {
            bindings = <

                /* ROW0 : SW1 - SW15 */
                &kp ESC
                &kp F1
                &kp F2
                &kp F3
                &kp F4
                &kp F5
                &kp F6
                &kp F7
                &kp F8
                &kp F9
                &kp F10
                &kp F11
                &kp F12
                &kp BSPC
                &kp DEL

                /* ROW1 : SW16 - SW33 */
                &kp JP_ZKHK
                &kp N1
                &kp N2
                &kp N3
                &kp N4
                &kp N5
                &kp N6
                &kp N7
                &kp N8
                &kp N9
                &kp N0
                &kp JP_MINS
                &kp JP_CIRC
                &kp JP_YEN

                &kp KP_NUM
                &kp KP_SLASH
                &kp KP_MULTIPLY
                &kp KP_MINUS

                /* ROW2 : SW34 - SW51 */
                &kp TAB
                &kp Q
                &kp W
                &kp E
                &kp R
                &kp T
                &kp Y
                &kp U
                &kp I
                &kp O
                &kp P
                &kp JP_AT
                &kp JP_LBRC
                &kp ENTER

                &kp KP_N7
                &kp KP_N8
                &kp KP_N9
                &kp KP_PLUS

                /* ROW3 : SW52 - SW67 */
                &kp CAPS
                &kp A
                &kp S
                &kp D
                &kp F
                &kp G
                &kp H
                &kp J
                &kp K
                &kp L
                &kp JP_SCLN
                &kp JP_COLN
                &kp JP_RBRC

                &kp KP_N4
                &kp KP_N5
                &kp KP_N6

                /* ROW4 : SW68 - SW85 */
                &kp LSHFT
                &kp Z
                &kp X
                &kp C
                &kp V
                &kp B
                &kp N
                &kp M
                &kp COMMA
                &kp DOT
                &kp FSLH
                &kp JP_BSLS
                &kp UP
                &kp RSHFT

                &kp KP_N1
                &kp KP_N2
                &kp KP_N3
                &kp KP_ENTER

                /* ROW5 : SW86 - SW99 */
                &kp LCTRL
                &mo FN
                &kp LGUI
                &kp LALT

                &kp SPACE
                &kp SPACE

                &kp JP_KANA

                &kp RALT
                &kp RCTRL

                &kp LEFT
                &kp DOWN
                &kp RIGHT

                &kp KP_N0
                &kp KP_DOT
            >;
        };


        /* =========================================================
         * FN layer
         *
         * Fn + Esc       = Soft Off
         * Fn + Backspace = RGB ON/OFF
         * Fn + ↑         = RGB brightness +
         * Fn + ↓         = RGB brightness -
         * Fn + ←         = Hue -
         * Fn + →         = Hue +
         *
         * &trans = BASE layerのキーをそのまま使う
         * ========================================================= */
        fn_layer {
            bindings = <

                /* ROW0 */
		&soft_off

		&bt BT_SEL 0
		&bt BT_SEL 1
		&bt BT_SEL 2
		&bt BT_SEL 3
		&bt BT_SEL 4

		&bt BT_CLR

		&trans
		&trans
		&trans
		&trans

		&out OUT_USB
		&out OUT_BLE

		&rgb_ug RGB_TOG

		&trans

                /* ROW1 */
                &trans &trans &trans &trans
                &trans &trans &trans &trans
                &trans &trans &trans &trans
                &trans &trans &trans &trans
                &trans &trans

                /* ROW2 */
                &trans &trans &trans &trans
                &trans &trans &trans &trans
                &trans &trans &trans &trans
                &trans &trans &trans &trans
                &trans &trans

                /* ROW3 */
                &trans &trans &trans &trans
                &trans &trans &trans &trans
                &trans &trans &trans &trans
                &trans &trans &trans &trans

                /* ROW4 */
                &trans &trans &trans &trans
                &trans &trans &trans &trans
                &trans &trans &trans &trans

                &rgb_ug RGB_BRI

                &trans &trans &trans &trans &trans

                /* ROW5 */
                &trans
                &trans
                &trans
                &trans

                &trans
                &trans

                &trans

                &trans
                &trans

                &rgb_ug RGB_HUD
                &rgb_ug RGB_BRD
                &rgb_ug RGB_HUI

                &trans
                &trans
            >;
        };
    };
};